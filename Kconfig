## Kconfig
```kconfig
config ZMK_OS_LAYER_DETECT_VIA_USB
    bool "It will attempt to detect the host operating system via USB"
    default n
```

## dts/bindings/behaviors/zmk,behavior-os-mod.yaml
```yaml
# Copyright (c) 2025 The ZMK Contributors
# SPDX-License-Identifier: MIT

description: OS-Mod Behavior

compatible: "zmk,behavior-os-mod"

include: zero_param.yaml

properties:
  bindings:
    type: phandle-array
    required: true
```

## dts/bindings/behaviors/zmk,behavior-os-selector.yaml
```yaml
# Copyright (c) 2025 The ZMK Contributors
# SPDX-License-Identifier: MIT
description: OS Selector behavior

compatible: "zmk,behavior-os-selector"

include: two_param.yaml
```

## dts/bindings/zmk,os-choose.yaml
```yaml
# Copyright (c) 2025 The ZMK Contributors
# SPDX-License-Identifier: MIT
description: Choose OS behavior

compatible: "zmk,os-choose"

include: one_param.yaml
```
