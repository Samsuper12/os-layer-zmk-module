/*
 * Copyright (c) 2025 The ZMK Contributors
 *
 * SPDX-License-Identifier: MIT
 */


/ {
	hid_dev_1: hid_dev_1 {
		compatible = "zephyr,hid-device";
		label = "HID2";
		protocol-code = "none";
		in-polling-period-us = <1000>;
		in-report-size = <64>;
	};
};