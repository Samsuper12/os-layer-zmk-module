/*
 * Copyright (c) 2025 The ZMK Contributors
 *
 * SPDX-License-Identifier: MIT
 */

/ {
    behaviors {
        os_choose: os_choose {
            compatible = "zmk,os-choose";
            #binding-cells = <1>;
        };
    };
};